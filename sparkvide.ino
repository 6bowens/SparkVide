
#include <clickButton.h>
#include <Encoder.h>
#include <DS18B20.h>
#include <OneWire.h>
#include <pid.h>
#include <Grove_OLED_128x64.h>

// Input pins
int ds18b20Pin = D7;
int relayPin = A5;

//Defines
DS18B20 ds18b20 = DS18B20(ds18b20Pin); // Temperature device on the D1 pin
Encoder myEnc(A0, A1); //rotary encoder

//Run without Wifi
SYSTEM_MODE(SEMI_AUTOMATIC)
SYSTEM_THREAD(ENABLED)

// PID: variables
double pointTemperature, actualTemperature, TempTemp, controlTemp;
double Kp = 0.1;  //www.over-engineered.com/projects/sous-vide-pid-controller/
double Ki = 150;
double Kd = 0.45;
int pidWindow = 10000; // i.e. wait 10 secs to act on PID
double upTime = 0; //Keep track of uptime
double controlOffset = -0.25;
double pidOutput = 0;
int heater = 1; 
int badTempCountLimit = 10; //Helps monitor for a short
int badTempCount = 0;
int counter = 0;
int pubDur = 60 * 1000;

// PID: Specify the links and initial tuning parameters
PID myPID(&actualTemperature, &pidOutput, &controlTemp, Kp, Ki, Kd, PID::DIRECT);

// Timestamp of the last status events
unsigned long lastEventTimestamp;
long oldPosition = 0;

static unsigned char SlowLogo[] PROGMEM ={
0x00, 0x00, 0x00, 0x00, 0x00, 0x00, 0x00, 0x00, 0x00, 0x00, 0x00, 0x00, 0x00, 0x00, 0x00, 0x00,
0x00, 0x00, 0x00, 0x00, 0x00, 0x00, 0x00, 0x00, 0x00, 0x00, 0x00, 0x00, 0x00, 0x00, 0x00, 0x00,
0x00, 0x00, 0x80, 0xB8, 0x68, 0x68, 0xD0, 0x00, 0x00, 0xE0, 0x20, 0xA0, 0xE0, 0x80, 0xA0, 0x60,
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0x0F, 0x0F, 0x0F, 0x0F, 0x00, 0x00, 0x00, 0x00, 0x00, 0x00, 0x00, 0x00, 0x00, 0x00, 0x00, 0x00
};

// Setup
void setup() {
    
    //Serial.begin(115200); //start a serial console
    Wire.begin();      //This needs to be here for the OLED to start i2c
    SeeedOled.init();  //initialze SEEED OLED display
    SeeedOled.clearDisplay();    // clear the screen and set start position to top left corner
    SeeedOled.drawBitmap(SlowLogo,1024);   // 1024 = 128 Pixels * 64 Pixels / 8

    // Set relay pin mode to output
    pinMode(relayPin, OUTPUT);
    digitalWrite(relayPin, HIGH);

    // Point temperature default
    pointTemperature = 131;
    controlTemp = pointTemperature + controlOffset; //apply an offset so the set temp is average of control cycle
    
    //PID controls
    myPID.SetSampleTime(1000);
    myPID.SetOutputLimits(0, pidWindow);
    myPID.SetTunings(Kp, Ki, Kd); // Not sure if I need this
    myPID.SetMode(PID::AUTOMATIC);
    
    lastEventTimestamp = 0; //set PID Window to 0
    
    delay(2000);   //slow this bitch down
    SeeedOled.clearDisplay(); //show off the logo
    Particle.connect();
}

 // Loop
void loop() {

    // Searching for the ds18b20 device
    if(actualTemperature == 0 && !ds18b20.search()) {
        ds18b20.resetsearch();
        delay(250);
    }

    // Read Temp (C)
    TempTemp = ds18b20.getTemperature();

    // ensures no incidents happen due to a short and filters out bad reads
    if (TempTemp > 0 && TempTemp < 100){ // temp reading is still in C
        actualTemperature = (TempTemp*9/5) + 32; //convert temp to F
        badTempCount = 0;
    }else{
        badTempCount++;
        if(badTempCount > badTempCountLimit){
            heater = 0;
        }
    }

    // Compute PID levels
    controlTemp = pointTemperature + controlOffset; //apply offset
    myPID.Compute();

   // Act on PID level every 10 secs
    if ((millis() - lastEventTimestamp) >= pidWindow) {
        lastEventTimestamp += pidWindow;
        if((pidOutput > 100) && (pidOutput > (millis() - lastEventTimestamp))) heater = 1;
        else heater = 0;
    }

    //act on PID/Mode decisions
    if (heater == 1) digitalWrite(relayPin, HIGH);
    else digitalWrite(relayPin, LOW);

    //post to cloud
    if (millis()-counter >= pubDur){
        particlePost();
        counter = millis();
    }
    
    //Read in the encoder position and apply it to the set temp
   long newPosition = myEnc.read();
   if (newPosition != oldPosition) {
        int delta = (newPosition - oldPosition)/4;
        pointTemperature += delta;
        oldPosition = newPosition;
   }
    
    screenRefresh(); // update the oled
    delay(100);   //slow this bitch down
}

int particlePost(){
    
    upTime = millis(); //Calculate Uptime
    String stringtemp = String(actualTemperature,1);
    String stringsettemp = String(pointTemperature,1);
    String stringuptime = String(upTime);
    String stringPID = String(pidOutput,1);
    
    if (Particle.connected()) {
    	Particle.publish("temp",stringtemp);
        Particle.publish("settemp",stringsettemp);
        Particle.publish("uptime",stringuptime);
        Particle.publish("PID",stringPID);
        if (heater == 1) Particle.publish("heater","true");
        if (heater == 0) Particle.publish("heater","false");
    }

    
    return 0;
}

int screenRefresh(){
    
    //SeeedOled.clearDisplay();
    SeeedOled.setNormalDisplay();
    SeeedOled.setPageMode();
    SeeedOled.setTextXY(1,0);
    SeeedOled.putString("Set Temp: ");
    SeeedOled.putFloat(pointTemperature);
    SeeedOled.setTextXY(4,0);
    SeeedOled.putString("Cur Temp: ");
    SeeedOled.putFloat(actualTemperature);
    
}